## sdkconfig.defaults
```kconfig
# 设置目标芯片为 ESP32-S3
CONFIG_IDF_TARGET="esp32s3"

# 基础设置
CONFIG_ESP_MAIN_TASK_STACK_SIZE=4096
CONFIG_LOG_DEFAULT_LEVEL_INFO=y

# 修正 PSRAM 配置为 Octal 模式 (针对 8MB 版本)
CONFIG_SPIRAM=y
CONFIG_SPIRAM_TYPE_AUTO=y
CONFIG_SPIRAM_MODE_OCT=y
CONFIG_SPIRAM_SPEED_80M=y
CONFIG_SPIRAM_SIZE=-1

# Prefer PSRAM for network buffers and medium allocations to preserve internal SRAM.
CONFIG_SPIRAM_MALLOC_ALWAYSINTERNAL=8192
CONFIG_SPIRAM_TRY_ALLOCATE_WIFI_LWIP=y
CONFIG_SPIRAM_MALLOC_RESERVE_INTERNAL=32768
CONFIG_SPIRAM_ALLOW_BSS_SEG_EXTERNAL_MEMORY=y

# 自定义分区表
CONFIG_PARTITION_TABLE_CUSTOM=y
CONFIG_PARTITION_TABLE_FILENAME="partitions.csv"
CONFIG_PARTITION_TABLE_OFFSET=0x8000

# LVGL SD 图片显示
CONFIG_LV_COLOR_DEPTH_16=y
CONFIG_LV_COLOR_DEPTH=16
CONFIG_LV_COLOR_16_SWAP=y
CONFIG_LV_USE_FS_POSIX=y
CONFIG_LV_FS_POSIX_LETTER=83
CONFIG_LV_FS_POSIX_PATH="/sdcard"
CONFIG_LV_USE_BMP=y
CONFIG_LV_USE_PNG=y
CONFIG_LV_USE_SJPG=y
CONFIG_LV_USE_GIF=y

CONFIG_BT_ENABLED=y

CONFIG_BTDM_CTRL_MODE_BLE_ONLY=y

CONFIG_BTDM_CTRL_MODE_BR_EDR_ONLY=n

CONFIG_BTDM_CTRL_MODE_BTDM=n

CONFIG_BT_BLUEDROID_ENABLED=n

CONFIG_BT_NIMBLE_ENABLED=y

# BLE only needs one peripheral connection for UniApp provisioning/IP discovery.
CONFIG_BT_NIMBLE_MAX_CONNECTIONS=1
CONFIG_BT_NIMBLE_MAX_BONDS=1
CONFIG_BT_NIMBLE_MAX_CCCDS=2
CONFIG_BT_NIMBLE_HOST_TASK_STACK_SIZE=3072
CONFIG_BT_NIMBLE_ROLE_CENTRAL=n
CONFIG_BT_NIMBLE_ROLE_PERIPHERAL=y
CONFIG_BT_NIMBLE_ROLE_BROADCASTER=y
CONFIG_BT_NIMBLE_ROLE_OBSERVER=n
CONFIG_BT_NIMBLE_SECURITY_ENABLE=n
CONFIG_BT_NIMBLE_ATT_PREFERRED_MTU=128
CONFIG_BT_NIMBLE_MSYS_1_BLOCK_COUNT=8
CONFIG_BT_NIMBLE_MSYS_2_BLOCK_COUNT=8
CONFIG_BT_NIMBLE_TRANSPORT_ACL_FROM_LL_COUNT=8
CONFIG_BT_NIMBLE_TRANSPORT_EVT_COUNT=16
CONFIG_BT_NIMBLE_WHITELIST_SIZE=2
CONFIG_BT_CTRL_BLE_MAX_ACT=2
CONFIG_BT_NIMBLE_MEM_ALLOC_MODE_INTERNAL=n
CONFIG_BT_NIMBLE_MEM_ALLOC_MODE_EXTERNAL=y
CONFIG_NIMBLE_MEM_ALLOC_MODE_INTERNAL=n
CONFIG_NIMBLE_MEM_ALLOC_MODE_EXTERNAL=y
CONFIG_NIMBLE_MAX_CONNECTIONS=1
CONFIG_NIMBLE_MAX_BONDS=1
CONFIG_NIMBLE_MAX_CCCDS=2
CONFIG_NIMBLE_TASK_STACK_SIZE=3072
CONFIG_BT_NIMBLE_TASK_STACK_SIZE=3072
CONFIG_NIMBLE_ROLE_CENTRAL=n
CONFIG_NIMBLE_ROLE_PERIPHERAL=y
CONFIG_NIMBLE_ROLE_BROADCASTER=y
CONFIG_NIMBLE_ROLE_OBSERVER=n
CONFIG_NIMBLE_ATT_PREFERRED_MTU=128
CONFIG_BT_NIMBLE_MSYS1_BLOCK_COUNT=8
CONFIG_BT_NIMBLE_ACL_BUF_COUNT=8
CONFIG_BT_NIMBLE_HCI_EVT_HI_BUF_COUNT=16
```
